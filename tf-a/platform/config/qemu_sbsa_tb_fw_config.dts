 /dts-v1/;
 / {
   tb_fw-config {
     compatible = "arm,tb_fw";
     disable_auth = <0x0>;
     mbedtls_heap_addr = <0x0 0x0>;
     mbedtls_heap_size = <0x0>;
   };
   secure-partitions {
     compatible = "arm,sp";
     stmm {
      uuid = "eaba83d8-baaf-4eaf-8144-f7fdcbe544a7";
      load-address = <0x20002000>;
      owner = "Plat";
    };
   };
 };
